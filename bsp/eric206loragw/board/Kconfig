## bsp/eric206loragw/board/Kconfig
```kconfig
menu "Hardware Drivers Config"

menu "Onboard Peripheral Drivers"
    config BSP_USING_SPI_FLASH
        bool "Enable SPI FLASH (W25Q64 spi2)"
        select BSP_USING_SPI
        select BSP_USING_SPI2
        select RT_USING_SFUD
        select RT_SFUD_USING_SFDP
        default n
endmenu

menu "On-chip Peripheral Drivers"

    config BSP_USING_GPIO
        bool "Enable GPIO"
        select RT_USING_PIN
        default y

    menuconfig BSP_USING_UART
        bool "Enable UART"
        default y
        select RT_USING_SERIAL
        if BSP_USING_UART

           config BSP_STM32_UART_V1_TX_TIMEOUT
                int "UART TX timeout"
                default 2000
                depends on RT_USING_SERIAL_V1

           config BSP_USING_UART1
                bool "Enable UART1"
                default y

                    config BSP_UART1_RX_USING_DMA
                        bool "Enable UART1 RX DMA"
                        depends on BSP_USING_UART1 && RT_SERIAL_USING_DMA
                        default n

                    config BSP_UART1_TX_USING_DMA
                        bool "Enable UART1 TX DMA"
                        depends on BSP_USING_UART1 && RT_SERIAL_USING_DMA
                        default n

                    config BSP_UART1_RX_BUFSIZE
                        int "Set UART1 RX buffer size"
                        range 64 65535
                        depends on RT_USING_SERIAL_V2
                        default 256

                    config BSP_UART1_TX_BUFSIZE
                        int "Set UART1 TX buffer size"
                        range 0 65535
                        depends on RT_USING_SERIAL_V2
                        default 0

            config BSP_USING_UART2
                bool "Enable UART2"
                default y

                    config BSP_UART2_RX_USING_DMA
                        bool "Enable UART2 RX DMA"
                        depends on BSP_USING_UART2 && RT_SERIAL_USING_DMA
                        default n

                    config BSP_UART2_TX_USING_DMA
                        bool "Enable UART2 TX DMA"
                        depends on BSP_USING_UART2 && RT_SERIAL_USING_DMA
                        default n

                    config BSP_UART2_RX_BUFSIZE
                        int "Set UART2 RX buffer size"
                        range 64 65535
                        depends on RT_USING_SERIAL_V2
                        default 256

                    config BSP_UART2_TX_BUFSIZE
                        int "Set UART2 TX buffer size"
                        range 0 65535
                        depends on RT_USING_SERIAL_V2
                        default 0

            config BSP_USING_UART3
                bool "Enable UART3"
                default y

                    config BSP_UART3_RX_USING_DMA
                        bool "Enable UART3 RX DMA"
                        depends on BSP_USING_UART3 && RT_SERIAL_USING_DMA
                        default n

                    config BSP_UART3_TX_USING_DMA
                        bool "Enable UART3 TX DMA"
                        depends on BSP_USING_UART3 && RT_SERIAL_USING_DMA
                        default n

                    config BSP_UART3_RX_BUFSIZE
                        int "Set UART3 RX buffer size"
                        range 64 65535
                        depends on RT_USING_SERIAL_V2
                        default 256

                    config BSP_UART3_TX_BUFSIZE
                        int "Set UART3 TX buffer size"
                        range 0 65535
                        depends on RT_USING_SERIAL_V2
                        default 0

        endif

        if BSP_USING_UART
            config BSP_USING_UART7
                bool "Enable UART7"
                default n
                config BSP_UART7_RX_USING_DMA
                    bool "Enable UART7 RX DMA"
                    depends on BSP_USING_UART7 && RT_SERIAL_USING_DMA
                    default n

                config BSP_UART7_TX_USING_DMA
                    bool "Enable UART7 TX DMA"
                    depends on BSP_USING_UART7 && RT_SERIAL_USING_DMA
                    default n

                config BSP_UART7_RX_BUFSIZE
                    int "Set UART7 RX buffer size"
                    range 64 65535
                    depends on RT_USING_SERIAL_V2
                    default 256

                config BSP_UART7_TX_BUFSIZE
                    int "Set UART7 TX buffer size"
                    range 0 65535
                    depends on RT_USING_SERIAL_V2
                    default 0
        endif

        if BSP_USING_UART
            config BSP_USING_UART6
                bool "Enable UART6"
                default n

                config BSP_UART6_RX_USING_DMA
                    bool "Enable UART6 RX DMA"
                    depends on BSP_USING_UART6 && RT_SERIAL_USING_DMA
                    default n

                config BSP_UART6_TX_USING_DMA
                    bool "Enable UART6 TX DMA"
                    depends on BSP_USING_UART6 && RT_SERIAL_USING_DMA
                    default n

                config BSP_UART6_RX_BUFSIZE
                    int "Set UART6 RX buffer size"
                    range 64 65535
                    depends on RT_USING_SERIAL_V2
                    default 256

                config BSP_UART6_TX_BUFSIZE
                    int "Set UART6 TX buffer size"
                    range 0 65535
                    depends on RT_USING_SERIAL_V2
                    default 0
        endif

    config BSP_USING_DAC1
        bool "Enable DAC1"
        select RT_USING_DAC
        default n
    config BSP_USING_DAC2
        bool "Enable DAC2"
        select RT_USING_DAC
        default n

    config BSP_USING_ADC1
        bool "Enable ADC1"
        select RT_USING_ADC
        default n
    config BSP_USING_ADC2
        bool "Enable ADC2"
        select RT_USING_ADC
        default n

    menuconfig BSP_USING_ONCHIP_RTC
        bool "Enable RTC"
        select RT_USING_RTC
        default n
        if BSP_USING_ONCHIP_RTC
            choice
                prompt "Select clock source"
                default BSP_RTC_USING_LSE

                config BSP_RTC_USING_LSE
                    bool "RTC USING LSE"

                config BSP_RTC_USING_LSI
                    bool "RTC USING LSI"
            endchoice
        endif

    menuconfig BSP_USING_PWM
        bool "Enable PWM"
        default n
        select RT_USING_PWM
        if BSP_USING_PWM
        menuconfig BSP_USING_PWM2
            bool "Enable timer2 output PWM"
            default n
            if BSP_USING_PWM2
                config BSP_USING_PWM2_CH2
                    bool "Enable PWM2 channel2"
                    default n
            endif
        endif

    menuconfig BSP_USING_SPI
        bool "Enable SPI BUS"
        default n
        select RT_USING_SPI
        if BSP_USING_SPI
            config BSP_USING_SPI1
                bool "Enable SPI1 BUS"
                default n

            config BSP_SPI1_TX_USING_DMA
                bool "Enable SPI1 TX DMA"
                depends on BSP_USING_SPI1
                default n

            config BSP_SPI1_RX_USING_DMA
                bool "Enable SPI1 RX DMA"
                depends on BSP_USING_SPI1
                select BSP_SPI1_TX_USING_DMA
                default n

            config BSP_USING_SPI2
                bool "Enable SPI2 BUS"
                default n

            config BSP_SPI2_TX_USING_DMA
                bool "Enable SPI2 TX DMA"
                depends on BSP_USING_SPI2
                default n

            config BSP_SPI2_RX_USING_DMA
                bool "Enable SPI2 RX DMA"
                depends on BSP_USING_SPI2
                select BSP_SPI2_TX_USING_DMA
                default n

            config BSP_USING_SPI3
                bool "Enable SPI3 BUS"
                default n

            config BSP_SPI3_TX_USING_DMA
                bool "Enable SPI3 TX DMA"
                depends on BSP_USING_SPI3
                default n

            config BSP_SPI3_RX_USING_DMA
                bool "Enable SPI3 RX DMA"
                depends on BSP_USING_SPI3
                select BSP_SPI3_TX_USING_DMA
                default n
        endif


    source "$BSP_DIR/../libraries/HAL_Drivers/drivers/Kconfig"

endmenu

menu "Board extended module Drivers"

endmenu

endmenu
```
